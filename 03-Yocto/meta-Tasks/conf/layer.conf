## 03-Yocto/meta-Tasks/conf/layer.conf
```bitbake
# We have a conf and classes directory, add to BBPATH
BBPATH .= ":${LAYERDIR}"

# We have recipes-* directories, add to BBFILES
BBFILES += "${LAYERDIR}/recipes-*/*/*.bb \
            ${LAYERDIR}/recipes-*/*/*.bbappend"

BBFILE_COLLECTIONS += "meta-Tasks"
BBFILE_PATTERN_meta-Tasks = "^${LAYERDIR}/"
BBFILE_PRIORITY_meta-Tasks = "6"


#LAYERDEPENDS_meta-Tasks  = "qt6-layer  meta-python networking-layer"


LAYERSERIES_COMPAT_meta-Tasks = "kirkstone"
```

## Yocto/meta-Tasks/conf/layer.conf
```bitbake
# We have a conf and classes directory, add to BBPATH
BBPATH .= ":${LAYERDIR}"

# We have recipes-* directories, add to BBFILES
BBFILES += "${LAYERDIR}/recipes-*/*/*.bb \
            ${LAYERDIR}/recipes-*/*/*.bbappend"

BBFILE_COLLECTIONS += "meta-Tasks"
BBFILE_PATTERN_meta-Tasks = "^${LAYERDIR}/"
BBFILE_PRIORITY_meta-Tasks = "6"

LAYERDEPENDS_meta-Tasks="meta-qt6 meta-python"

LAYERDEPENDS_meta-Tasks = "qt6 networking"
LAYERSERIES_COMPAT_meta-Tasks = "kirkstone"
```
